## config/west.yml
```yaml
manifest:
  remotes:
    - name: zmkfirmware
      url-base: https://github.com/zmkfirmware
    - name: ftc 
      url-base: https://github.com/ftc
    - name: track 
      url-base: https://github.com/victorlucachi
  projects:
    - name: zmk
      remote: track
      revision: pmw3610-aml
      import: app/west.yml
  self:
    path: config
```
